## components/ota_manager/Kconfig.projbuild
```kconfig
menu "OTA Manager"

    config OTA_MQTT_BROKER
        string "MQTT Broker URI"
        default "mqtt://your-rhel-server-ip"
        help
            URI of the MQTT broker. Use mqtt:// for plain or mqtts:// for TLS.
            Example: mqtt://192.168.1.100

    config OTA_MQTT_PORT
        int "MQTT Broker Port"
        default 1883
        help
            Port the MQTT broker listens on.
            Default unencrypted: 1883
            Default TLS: 8883

    config OTA_MQTT_USERNAME
        string "MQTT Username"
        default "esp32_device"
        help
            Username configured in Mosquitto for this device.

    config OTA_MQTT_PASSWORD
        string "MQTT Password"
        default ""
        help
            Password for the MQTT user above.

    config OTA_MQTT_TOPIC
        string "OTA Trigger Topic"
        default "ota/trigger"
        help
            MQTT topic the ESP32 subscribes to for OTA triggers.
            The message payload must be the full HTTP URL of the firmware .bin file.
            Example payload: http://192.168.1.100/firmware/app.bin

endmenu
```

## main/Kconfig.projbuild
```kconfig
menu "WIFI Fallback Credentials"

    config WIFI_FALLBACK_SSID
        string "Fallback SSID"
        default ""
        help
            Used if NVS has no credentials stored.
    
    config WIFI_FALLBACK_PASSWORD
        string "Fallback Password"
        default ""
        help
            Used if NVS has no credentials stored. 

endmenu
```

## sdkconfig.defaults.local
```kconfig
CONFIG_WIFI_FALLBACK_SSID = "dlink-2160"
CONFIG_WIFI_FALLBACK_PASSWORD = "ABCDEF0123456789ABCDEF0123"
```
